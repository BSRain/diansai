//cryfucns.c
 
#include <msp430.h>
#include "cryfucns.h"
 
#define BIT(x)	(1 << (x))
 
const unsigned char shuzi_table[];
/*
  rw p3.1
  e p3.2
*/
/**********液晶控制IO的宏定义*************/
#define cyCS      0    //P3.0，片选信号
#define cySID     1    //P3.1，串行数据  
#define cyCLK     2    //P3.2，同步时钟
#define cyPORT    P3OUT  
#define cyDDR     P3DIR
 
/*******************************************
函数名称：delay_Nus
功    能：延时N个us的时间
参    数：n--延时长度
返回值  ：无
********************************************/
void delay_Nus(uint n)
{
	uchar i;
	for (i = n; i > 0; i--)
		_NOP();

}
/*******************************************
函数名称：delay_1ms
功    能：延时约1ms的时间
参    数：无
返回值  ：无
********************************************/
void delay_1ms(void)
{
	uchar i;
	for (i = 150; i > 0; i--)	  _NOP();
}
/*******************************************
函数名称：delay_Nms
功    能：延时N个ms的时间
参    数：无
返回值  ：无
********************************************/
void delay_Nms(uint n)
{
	uint i = 0;
 
	for (i = n; i > 0; i--)
		delay_1ms();
}
/*******************************************
函数名称：Ini_Lcd
功    能：初始化液晶模块
参    数：无
返回值  ：无
********************************************/
void Ini_Lcd(void)
{
  
	cyDDR |= BIT(cyCLK) + BIT(cySID) + BIT(cyCS);   //相应的位端口设置为输出
	delay_Nms(100);                 //延时等待液晶完成复位
	Send(0, 0x30);  /*功能设置:一次送8位数据,基本指令集*/
	delay_Nus(72);
	Send(0, 0x02);  /*DDRAM地址归位*/
	delay_Nus(72);
	Send(0, 0x0c);  /*显示设定:开显示,不显示光标,不做当前显示位反白闪动*/
	delay_Nus(72);
	Send(0, 0x01);  /*清屏，将DDRAM的位址计数器调整为“00H”*/
	delay_Nus(72);
	Send(0, 0x06);  /*功能设置，点设定:显示字符/光标从左到右移位,DDRAM地址加1*/
	delay_Nus(72);
}
/*******************************************
函数名称：Send
功    能：MCU向液晶模块发送1一个字节的数据
参    数：type--数据类型，0--控制命令，1--显示数据
		  transdata--发送的数据
返回值  ：无
********************************************/
void Send(uchar type, uchar transdata)
{
	uchar firstbyte = 0xf8;
	uchar temp;
	uchar i, j = 3;
 
	if (type) firstbyte |= 0x02;
 
	cyPORT |= BIT(cyCS);
	cyPORT &= ~BIT(cyCLK);
	while (j > 0)
	{
		if (j == 3) temp = firstbyte;
		else if (j == 2) temp = transdata & 0xf0;
		else  temp = (transdata << 4) & 0xf0;
 
		for (i = 8; i > 0; i--)
		{
			if (temp & 0x80)	cyPORT |= BIT(cySID);
			else			cyPORT &= ~BIT(cySID);
			cyPORT |= BIT(cyCLK);
			temp <<= 1;
			cyPORT &= ~BIT(cyCLK);
		}
		//三个字节之间一定要有足够的延时，否则易出现时序问题
		if (j == 3) delay_Nus(600);
		else       delay_Nus(200);
 
		j--;
	}
 
	cyPORT &= ~BIT(cySID);
	cyPORT &= ~BIT(cyCS);
}
/*******************************************
函数名称：Clear_GDRAM
功    能：清除液晶GDRAM内部的随机数据
参    数：无
返回值  ：无
********************************************/
void Clear_GDRAM(void)
{
	uchar i, j, k;
 
	Send(0, 0x34);        //打开扩展指令集
	i = 0x80;
	for (j = 0; j < 32; j++)
	{
		Send(0, i++);
		Send(0, 0x80);
		for (k = 0; k < 16; k++)
		{
			Send(1, 0x00);
		}
	}
	i = 0x80;
	for (j = 0; j < 32; j++)
	{
		Send(0, i++);
		Send(0, 0x88);
		for (k = 0; k < 16; k++)
		{
			Send(1, 0x00);
		}
	}
	Send(0, 0x30);        //回到基本指令集	
}
/*******************************************
函数名称：Disp_HZ
功    能：显示汉字程序
参    数：addr--显示位置的首地址
		  pt--指向显示数据的指针
		  num--显示数据的个数
返回值  ：无
********************************************/
void Disp_HZ(uchar addr, const uchar* pt, uchar num)
{
	uchar i;
 
	Send(0, addr);
	//for(i = 0;i < (num*2);i++)
	while (*pt != '\0')
		Send(1, *(pt++));
}
/*******************************************
函数名称：Draw_PM
功    能：在整个屏幕上画一个图片
参    数：ptr--指向保存图片位置的指针
返回值  ：无
********************************************/
void Draw_PM(const uchar* ptr)
{
	uchar i, j, k;
 
	Send(0, 0x34);        //打开扩展指令集
	i = 0x80;
	for (j = 0; j < 32; j++)
	{
		Send(0, i++);
		Send(0, 0x80);   //上屏
		for (k = 0; k < 16; k++)
		{
			Send(1, *ptr++);
		}
	}
	/**/
	i = 0x80;
	for (j = 0; j < 32; j++)
	{
		Send(0, i++);
		Send(0, 0x88); 	 //下屏
		for (k = 0; k < 16; k++)
		{
			Send(1, *ptr++);
		}
	}
	Send(0, 0x36);		        //打开绘图显示
	Send(0, 0x30);               //回到基本指令集	
}
/*******************************************
函数名称：Draw_TX
功    能：在液晶上描绘一个16*16的图形
参    数：Yaddr--Y地址，
		  Xaddr--X地址
		  dp--指向保存图形数据的指针
返回值  ：无
********************************************/
void Draw_TX(uchar Yaddr, uchar Xaddr, const uchar* dp)
{
	uchar j;
	uchar k = 0;
 
	Send(0, 0x34);           //使用扩展指令集，关闭绘图显示
	for (j = 0; j < 16; j++)
	{
		Send(0, Yaddr++);     //Y地址  
		Send(0, Xaddr);       //X地址
		Send(1, dp[k++]);     //送两个字节的显示数据 
		Send(1, dp[k++]);
	}
	Send(0, 0x36);		    //打开绘图显示
	Send(0, 0x30);		    //回到基本指令集模式
}
/*******************************************
函数名称：Disp_SZ
功    能：显示一个两位数字
参    数：addr--显示地址
		  数字--显示的数字
返回值  ：无
********************************************/
void Disp_SZ(uchar addr, uchar shuzi)
{
	//uchar tmp0, tmp1;
 
	//tmp0 = shuzi ;
	//tmp1 = shuzi % 10;
 
	Send(0, addr);
	Send(1, shuzi);
	//Send(1, shuzi_table[tmp1]);
}
void Disp_ZSZ(uchar addr, int shuzi)
{
  Send(0, addr);
  //char num[100];
  //itoa(shuzi,num[0],10)
  char num=(char)shuzi;
  Send(1, num);
}
 
void ShowIMG(const uchar* ptr, uchar h, uchar w)
{
	uchar i, x, y;
	int count = 0;
	w /= 8;
 
	Send(0, 0x34);        //打开扩展指令集
	//Send(0,0x34);        //打开扩展指令集
	for (i = 0; i < 2; i++)   //上下屏写入
	{
		for (y = 0; y < 32; y++)   //垂直Y写32次
		{
			Send(0, 0x80 + y);       //行地址
			Send(0, 0x80 + i * 8);   //列地址
 
			for (x = 0; x < 16; x++)   //横向X写8次
			{
				if (x < w && count < h)
					Send(1, *ptr++);     //写字节数据
				else
					Send(1, 0x00);     //写字节数据
			}
			count++;
		}
	}
 
	Send(0, 0x36);               //打开绘图显示
	Send(0, 0x30);               //回到基本指令集
}
 
 
//======================================================
// 128X64I液晶底层驱动[8X16]字体库
// 重新取模   (横向取模,字节倒序)
// 描  述: [8X16]西文字符的字模数据
// !"#$%&'()*+,-./0123456789:;<=>?@ABCDEFGHIJKLMNOPQRSTUVWXYZ[\]^_`abcdefghijklmnopqrstuvwxyz{|}~
//======================================================
// 字高16X16
const uchar F8X16[] =
{
  0x00,0x00,0x00,0x00,0x00,0x00,0x00,0x00,0x00,0x00,0x00,0x00,0x00,0x00,0x00,0x00,// 0
  0x00,0x00,0x00,0x10,0x10,0x10,0x10,0x10,0x10,0x10,0x00,0x00,0x10,0x10,0x00,0x00,/*"!",0*/
  0x00,0x12,0x24,0x24,0x48,0x00,0x00,0x00,0x00,0x00,0x00,0x00,0x00,0x00,0x00,0x00,/*""",1*/
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  0x20,0x5A,0x04,0x00,0x00,0x00,0x00,0x00,0x00,0x00,0x00,0x00,0x00,0x00,0x00,0x00,/*"~",3*/
 
};
 
uchar ONE_CHAR[] = {
	0x00,0x00,0x00,0x00,0x00,0x00,0x00,0x00,0x00,0x00,0x00,0x00,0x00,0x00,0x00,0x00,// 0
	0x00,0x00,0x00,0x00,0x00,0x00,0x00,0x00,0x00,0x00,0x00,0x00,0x00,0x00,0x00,0x00,// 0
};
 
 
//LCD 横向地址8个  每个16位数据
void LCD_ShowChar(char x, char y, char ch1, char ch2)
{
	char i, j;
	char c = 0;
	//合成一个16X16字符的模
	Str2IN1(ch1, ch2);
 
	for (i = 0; i < 16; i++)
	{
		if (y + i >= 32)
		{
			y = y + i - 32;
			break;
		}
		Send(0, 0x80 + y + i);   //行地址
		Send(0, 0x80 + x);       //列地址   一行8个16位
		Send(1, ONE_CHAR[c++]);           //写数据
		Send(1, ONE_CHAR[c++]);           //写数据
	}
	for (j = 0; j + i < 16; j++)
	{
		Send(0, 0x80 + y + j);   //行地址
		Send(0, 0x88 + x);       //列地址   一行8个16位
		Send(1, ONE_CHAR[c++]);           //写数据
		Send(1, ONE_CHAR[c++]);           //写数据
	}
}
 
void LCD_ShowCharCH(char x, char y, char* CH)
{
	char i, j;
 
	for (i = 0; i < 16; i++)
	{
		if (y + i >= 32)
		{
			y = y + i - 32;
			break;
		}
		Send(0, 0x80 + y + i);   //行地址
		Send(0, 0x80 + x);       //列地址   一行8个16位
		Send(1, *CH++);           //写数据
		Send(1, *CH++);           //写数据
	}
	for (j = 0; j + i < 16; j++)
	{
		Send(0, 0x80 + y + j);   //行地址
		Send(0, 0x88 + x);       //列地址   一行8个16位
		Send(1, *CH++);           //写数据
		Send(1, *CH++);           //写数据
	}
}
 
//x取0-15        y取0-63
void LCD_ShowStrCH(char x, char y, char* ch, char num)
{
	Send(0, 0x34);        //打开扩展指令集
	while (num--)
	{
		LCD_ShowCharCH(x++, y, ch);
		ch += 32;
	}
	Send(0, 0x36);               //打开绘图显示
	Send(0, 0x30);               //回到基本指令集
}
//x取0-15        y取0-63
void LCD_ShowStr(char x, char y, char* ch)
{
	Send(0, 0x34);        //打开扩展指令集
	char i = 0;
	for (;;)
	{
		i++;
		if (*ch++ == '\0')
		{
			if (i == 2)
			{
				LCD_ShowChar(x++, y, *(ch - 2), ' ');
			}
			break;
		}
		else if (i == 2)
		{
			i = 0;
			LCD_ShowChar(x++, y, *(ch - 2), *(ch - 1));
		}
	}
 
	Send(0, 0x36);               //打开绘图显示
	Send(0, 0x30);               //回到基本指令集
}
 
//把两个16X8的模合成一个16X16的模
void Str2IN1(char a1, char a2)
{
	char i;
	unsigned int c1, c2;
	c1 = (a1 - 32) * 16;
	c2 = (a2 - 32) * 16;
 
	for (i = 0; i < 16; i++)
	{
		ONE_CHAR[i * 2] = F8X16[c1++];
		ONE_CHAR[i * 2 + 1] = F8X16[c2++];
	}
}
 
void LCD_ClearPic(void)
{
	uchar i, x, y;
 
 
	Send(0, 0x34);        //打开扩展指令集
	for (i = 0; i < 2; i++)   //上下屏写入
	{
		for (y = 0; y < 32; y++)   //垂直Y写32次
		{
			Send(0, 0x80 + y);       //行地址
			Send(0, 0x80 + i * 8);   //列地址
 
			for (x = 0; x < 16; x++)   //横向X写8次
			{
				Send(1, 0x00);     //写字节数据
			}
		}
	}
 
	Send(0, 0x36);               //打开绘图显示
	Send(0, 0x30);               //回到基本指令集
}
 
 
 
 